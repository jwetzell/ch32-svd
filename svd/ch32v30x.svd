# CH32V30X register map
Vendor: WCH Ltd.; File version: 1.0
CH32V30xxx View File
Registers are 32-bit, read-write, reset 0x0 unless marked. A register's access mark holds for its fields unless they carry their own. Offsets are from the block's base; lines under a group give offsets from that group; [hi:lo] are bit positions; {n}, {i} and the like mark numbered series; 'fields as' and 'values as' point back to an identical list; <NAME> marks a mode.

## Memory map
0x40000000 TIM2 size 0x400 — General purpose timer
0x40000400 TIM3 size 0x400
0x40000800 TIM4 size 0x400
0x40000C00 TIM5 size 0x400
0x40001000 TIM6 size 0x400 — Basic timer
0x40001400 TIM7 size 0x400
0x40001800 UART6 size 0x400
0x40001C00 UART7 size 0x400
0x40002000 UART8 size 0x400
0x40002800 RTC size 0x400 — Real time clock
0x40002C00 WWDG size 0x400 — Window watchdog
0x40003000 IWDG size 0x400 — Independent watchdog
0x40003800 SPI2 size 0x400 — Serial peripheral interface
0x40003C00 SPI3 size 0x400
0x40004400 USART2 size 0x400
0x40004800 USART3 size 0x400
0x40004C00 UART4 size 0x400
0x40005000 UART5 size 0x400
0x40005400 I2C1 size 0x400 — Inter integrated circuit
0x40005800 I2C2 size 0x400
0x40005C00 USB size 0x400 — Universal serial bus full-speed device interface
0x40006400 CAN1 size 0x400 — Controller area network
0x40006800 CAN2 size 0x400
0x40006C00 BKP size 0x400 — Backup registers
0x40007000 PWR size 0x400 — Power control
0x40007400 DAC size 0x400 — Digital to analog converter
0x40010000 AFIO size 0x400 — Alternate function I/O
0x40010400 EXTI size 0x400
0x40010800 GPIOA size 0x400 — General purpose I/O
0x40010C00 GPIOB size 0x400
0x40011000 GPIOC size 0x400
0x40011400 GPIOD size 0x400
0x40011800 GPIOE size 0x400
0x40012400 ADC1 size 0x400 — Analog to digital converter
0x40012800 ADC2 size 0x400 — Analog to digital converter
0x40012C00 TIM1 size 0x400 — Advanced timer
0x40013000 SPI1 size 0x400 — Serial peripheral interface
0x40013400 TIM8 size 0x400
0x40013800 USART1 size 0x400 — Universal synchronous asynchronous receiver transmitter
0x40014C00 TIM9 size 0x400
0x40015000 TIM10 size 0x400
0x40018000 SDIO size 0x400 — Secure digital input/output interface
0x40020000 DMA1 size 0x400 — DMA1 controller
0x40020400 DMA2 size 0x400 — DMA2 controller
0x40021000 RCC size 0x400 — Reset and clock control
0x40022000 FLASH size 0x400
0x40023000 CRC size 0x400 — CRC calculation unit
0x40023400 USBHD size 0x400 — USB register
0x40023800 EXTEND size 0x400 — Extend configuration
0x40023804 OPA size 0x200 — OPA configuration
0x40023C00 RNG size 0x400 — Random number generator
0x40028000 ETHERNET_MAC size 0x400 — Ethernet: media access control
0x40028100 ETHERNET_MMC size 0x400 — Ethernet: MAC management counters
0x40028700 ETHERNET_PTP size 0x400 — Ethernet: Precision time protocol
0x40029000 ETHERNET_DMA size 0x400 — Ethernet: DMA controller operation
0x50000000 USB_OTG_FS size 0x40000 — USB FS OTG register
0x50050000 DVP size 0x400 — Digital Video Port
0xA0000000 FSMC size 0x1000 — Flexible static memory controller
0xE000D000 DBG size 0x400 — Debug support
0xE000E000 PFIC size 0x1100 — Programmable Fast Interrupt Controller
0xE000F000 SYSTICK — Systick registers, 64-bit downcounter for QingKeV4

## Interrupts
16 WWDG — Window Watchdog interrupt
17 PVD (PWR) — PVD through EXTI line detection interrupt
18 TAMPER (EXTI) — Tamper interrupt
19 RTC — RTC global interrupt
20 FLASH — Flash global interrupt
21 RCC — RCC global interrupt
22 EXTI0 (EXTI) — EXTI Line0 interrupt
23 EXTI1 (EXTI) — EXTI Line1 interrupt
24 EXTI2 (EXTI) — EXTI Line2 interrupt
25 EXTI3 (EXTI) — EXTI Line3 interrupt
26 EXTI4 (EXTI) — EXTI Line4 interrupt
27 DMA1_Channel1 (DMA1) — DMA1 Channel1 global interrupt
28 DMA1_Channel2 (DMA1) — DMA1 Channel2 global interrupt
29 DMA1_Channel3 (DMA1) — DMA1 Channel3 global interrupt
30 DMA1_Channel4 (DMA1) — DMA1 Channel4 global interrupt
31 DMA1_Channel5 (DMA1) — DMA1 Channel5 global interrupt
32 DMA1_Channel6 (DMA1) — DMA1 Channel6 global interrupt
33 DMA1_Channel7 (DMA1) — DMA1 Channel7 global interrupt
34 ADC (ADC1) — ADC global interrupt
35 USB_HP_CAN1_TX (CAN1) — CAN1 TX interrupts
36 USB_LP_CAN1_RX0 (CAN1) — CAN1 RX0 interrupts
37 CAN1_RX1 (CAN1) — CAN1 RX1 interrupt
38 CAN1_SCE (CAN1) — CAN1 SCE interrupt
39 EXTI9_5 (EXTI) — EXTI Line[9:5] interrupts
40 TIM1_BRK (TIM1) — TIM1 Break interrupt
41 TIM1_UP_ (TIM1) — TIM1 Update interrupt
42 TIM1_TRG_COM (TIM1) — TIM1 Trigger and Commutation interrupts
43 TIM1_CC (TIM1) — TIM1 Capture Compare interrupt
44 TIM2 — TIM2 global interrupt
45 TIM3 — TIM3 global interrupt
46 TIM4 — TIM4 global interrupt
47 I2C1_EV (I2C1) — I2C1 event interrupt
48 I2C1_ER (I2C1) — I2C1 error interrupt
49 I2C2_EV (I2C2) — I2C2 event interrupt
50 I2C2_ER (I2C2) — I2C2 error interrupt
51 SPI1 — SPI1 global interrupt
52 SPI2 — SPI2 global interrupt
53 USART1 — USART1 global interrupt
54 USART2 — USART2 global interrupt
55 USART3 — USART3 global interrupt
56 EXTI15_10 (EXTI) — EXTI Line[15:10] interrupts
57 RTCAlarm (RTC) — RTC Alarms through EXTI line interrupt
58 USBWakeUp (USB) — USB Device WakeUp from suspend through EXTI Line Interrupt
59 TIM8_BRK (TIM8) — TIM8 Break interrupt
60 TIM8_UP_ (TIM8) — TIM8 Update interrupt
61 TIM8_TRG_COM (TIM8) — TIM8 Trigger and Commutation interrupts
62 TIM8_CC (TIM8) — TIM8 Capture Compare interrupt
63 RNG — RNG interrupt
64 FSMC — FSMC global interrupt
65 SDIO — SDIO global interrupt
66 TIM5 — TIM5 global interrupt
67 SPI3 — SPI3 global interrupt
68 UART4 — UART4 global interrupt
69 UART5 — UART5 global interrupt
70 TIM6 — TIM6 Basic interrupt
71 TIM7 — TIM8 Basic interrupt
72 DMA2_Channel1 (DMA2) — DMA2 Channel1 global interrupt
73 DMA2_Channel2 (DMA2) — DMA2 Channel2 global interrupt
74 DMA2_Channel3 (DMA2) — DMA2 Channel3 global interrupt
75 DMA2_Channel4 (DMA2) — DMA2 Channel4 global interrupt
76 DMA2_Channel5 (DMA2) — DMA2 Channel5 global interrupt
77 ETH (ETHERNET_MAC) — Ethernet global interrupt
78 ETH_WKUP (ETHERNET_MAC) — Ethernet Wakeup through EXTI line interrupt
79 CAN2_TX (CAN2) — CAN2 TX interrupts
80 CAN2_RX0 (CAN2) — CAN2 RX0 interrupts
81 CAN2_RX1 (CAN2) — CAN2 RX1 interrupt
82 CAN2_SCE (CAN2) — CAN2 SCE interrupt
83 OTG_FS (USB_OTG_FS)
84 USBHSWakeup (USBHD, USB_OTG_FS)
85 USBHS (USBHD, USB_OTG_FS)
86 DVP — DVP global Interrupt interrupt
87 UART6 — UART6 global interrupt
88 UART7 — UART7 global interrupt
89 UART8 — UART8 global interrupt
90 TIM9_BRK (TIM9) — TIM9 Break interrupt
91 TIM9_UP_ (TIM9) — TIM9 Update interrupt
92 TIM9_TRG_COM (TIM9) — TIM9 Trigger and Commutation interrupts
93 TIM9_CC (TIM9) — TIM9 Capture Compare interrupt
94 TIM10_BRK (TIM10) — TIM10 Break interrupt
95 TIM10_UP_ (TIM10) — TIM10 Update interrupt
96 TIM10_TRG_COM (TIM10) — TIM10 Trigger and Commutation interrupts
97 TIM10_CC (TIM10) — TIM10 Capture Compare interrupt
98 DMA2_Channel6 (DMA2) — DMA2 Channel6 global interrupt
99 DMA2_Channel7 (DMA2) — DMA2 Channel7 global interrupt
100 DMA2_Channel8 (DMA2) — DMA2 Channel8 global interrupt
101 DMA2_Channel9 (DMA2) — DMA2 Channel9 global interrupt
102 DMA2_Channel10 (DMA2) — DMA2 Channel10 global interrupt
103 DMA2_Channel11 (DMA2) — DMA2 Channel11 global interrupt
