# CH32L103 register map
Vendor: WCH Ltd.; File version: 1.0
CH32L103 View File
Registers are 32-bit, read-write, reset 0x0 unless marked. A register's access mark holds for its fields unless they carry their own. Offsets are from the block's base; lines under a group give offsets from that group; [hi:lo] are bit positions; {n}, {i} and the like mark numbered series; 'fields as' and 'values as' point back to an identical list; <NAME> marks a mode.

## Memory map
0x40000000 TIM2 size 0x400 — General purpose timer
0x40000400 TIM3 size 0x400
0x40000800 TIM4 size 0x400 — Timer4
0x40002800 RTC size 0x400 — Real time clock
0x40002C00 WWDG size 0x400 — Window watchdog
0x40003000 IWDG size 0x400 — Independent watchdog
0x40003800 SPI2 size 0x400
0x40004400 USART2 size 0x400
0x40004800 USART3 size 0x400
0x40004C00 UART4 size 0x400
0x40005400 I2C1 size 0x400 — Inter integrated circuit
0x40005800 I2C2 size 0x400
0x40006400 CAN size 0x400 — Controller area network
0x40006C00 BKP size 0x400 — Backup registers
0x40007000 PWR size 0xC00 — Power control
0x40007C00 LPTIM size 0x100 — Low-power timer
0x40010000 AFIO size 0x400 — Alternate function I/O
0x40010400 EXTI size 0x400
0x40010800 GPIOA size 0x400 — General purpose I/O
0x40010C00 GPIOB size 0x400
0x40011000 GPIOC size 0x400
0x40011400 GPIOD size 0x400
0x40012400 ADC__TKEY size 0x400 — Analog to digital converter_TOUCHKEY detection
0x40012C00 TIM1 size 0x400 — Advanced timer
0x40013000 SPI1 size 0x400 — Serial peripheral interface
0x40013800 USART1 size 0x400 — Universal synchronous asynchronous receiver transmitter
0x40020000 DMA size 0x400 — DMA controller
0x40021000 RCC size 0x400 — Reset and clock control
0x40022000 FLASH size 0x400
0x40023000 CRC size 0x400 — CRC calculation unit
0x40023800 EXTEN size 0x400 — Exten configuration
0x40026000 OPA size 0x400 — OPA configuration
0x40027000 USBPD size 0x400 — USBPD control register
0x50000000 USBFS size 0x400 — USB full speed host/equipment control register
0xE000D000 DBG size 0x400 — Debug support
0xE000E000 PFIC size 0x1100 — Programmable Fast Interrupt Controller
0xE000F000 SYSTICK — Systick registers, 64-bit downcounter for QingKeV4

## Interrupts
16 WWDG — Window Watchdog interrupt
17 PVD (PWR) — PVD through EXTI line detection interrupt
18 TAMPER (EXTI) — Tamper interrupt
19 RTC — RTC global interrupt
20 FLASH — Flash global interrupt
21 RCC — RCC global interrupt
22 EXTI0 (EXTI) — EXTI Line0 interrupt
23 EXTI1 (EXTI) — EXTI Line1 interrupt
24 EXTI2 (EXTI) — EXTI Line2 interrupt
25 EXTI3 (EXTI) — EXTI Line3 interrupt
26 EXTI4 (EXTI) — EXTI Line4 interrupt
27 DMA_CH1 (DMA) — DMA Channel1 global interrupt
28 DMA_CH2 (DMA) — DMA Channel2 global interrupt
29 DMA_CH3 (DMA) — DMA Channel3 global interrupt
30 DMA_CH4 (DMA) — DMA Channel4 global interrupt
31 DMA_CH5 (DMA) — DMA Channel5 global interrupt
32 DMA_CH6 (DMA) — DMA Channel6 global interrupt
33 DMA_CH7 (DMA) — DMA Channel7 global interrupt
34 ADC (ADC__TKEY) — ADC global interrupt
35 USB_HP_CAN_TX (CAN) — CAN TX interrupts
36 USB_LP_CAN_RX0 (CAN) — CAN RX0 interrupts
37 CAN_RX1 (CAN) — CAN RX1 interrupt
38 CAN_SCE (CAN) — CAN SCE interrupt
39 EXTI9_5 (EXTI) — EXTI Line[9:5] interrupts
40 TIM1_BRK (TIM1) — TIM1 Break interrupt
41 TIM1_UP_ (TIM1) — TIM1 Update interrupt
42 TIM1_TRG_COM (TIM1) — TIM1 Trigger and Commutation interrupts
43 TIM1_CC (TIM1) — TIM1 Capture Compare interrupt
44 TIM2 — TIM2 global interrupt
45 TIM3 — TIM3 global interrupt
46 TIM4 — TIM4 global interrupt
47 I2C1_EV (I2C1) — I2C1 event interrupt
48 I2C1_ER (I2C1) — I2C1 error interrupt
49 I2C2_EV (I2C2) — I2C2 event interrupt
50 I2C2_ER (I2C2) — I2C2 error interrupt
51 SPI1 — SPI1 global interrupt
52 SPI2 — SPI2 global interrupt
53 USART1 — USART1 global interrupt
54 USART2 — USART2 global interrupt
55 USART3 — USART3 global interrupt
56 EXTI15_10 (EXTI) — EXTI Line[15:10] interrupts
57 RTCAlarm (RTC) — RTC Alarms through EXTI line interrupt
58 LPTIM_WKUP (LPTIM) — LPTIM wake-up interrupt
59 USBFS — USBFS global interrupt
60 USBFS_WKUP (USBFS) — USBFS wake-up interrupt
61 UART4 — UART4 global interrupt
62 DMA_CH8 (DMA) — DMA Channel8 global interrupt
63 LPTIM — LPTIM global interrupt
64 OPA — OPA global interrupts
65 USBPD — USBPD global interrupt
66 TKEY_WKUP (ADC__TKEY) — TKEY wake-up interrupt
67 USBPD_WKUP (USBPD) — USBPD wake-up interrupt
